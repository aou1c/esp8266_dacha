## simple/main/Kconfig.projbuild
```kconfig
menu "Example Configuration"

config WIFI_SSID
    string "WiFi SSID"
    default "LEDE"
    help
        SSID (network name) for the example to connect to.
config WIFI_PASSWORD
    string "WiFi Password"
    default "mypassword"
    help
        WiFi password (WPA or WPA2) for the example to use.
        Can be left blank if the network has no security set.
config SERVER_IP
    string "OTA SERVER IP"
    default "myssid"
    help
        SSID (network name) for the example to connect to.
config SERVER_PORT
    string "OTA SERVER PORT"
    default "myssid"
    help
        SSID (network name) for the example to connect to.
config EXAMPLE_FILENAME
    string "OTA FILENAME"
    default "myssid"
    help
        SSID (network name) for the example to connect to.
endmenu
```
